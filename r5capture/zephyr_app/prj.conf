## CMakeLists.txt
```
cmake_minimum_required(VERSION 3.28.0)
# Copyright (c) 2020 STMicroelectronics
#
# SPDX-License-Identifier: Apache-2.0
#

find_package(Zephyr REQUIRED HINTS $ENV{ZEPHYR_BASE})

project(r5capture_firmware)

target_include_directories(app PRIVATE ${LIBMETAL_INCLUDE_DIR} ${OPENAMP_INCLUDE_DIR} ${PLATFORM_DIR})

# main_remote.c: Zephyr's OpenAMP resource-table sample (v4.5.0), unchanged.
# It provides the resource table remoteproc needs, RPMsg, and the shell over RPMsg.
# SPI to the MCP3208: "mcspi" (hardware MCU_SPI0, default) or "gpio" (bit-banged)
set(R5CAP_SPI mcspi CACHE STRING "SPI implementation: mcspi or gpio")
target_sources(app PRIVATE src/main_remote.c src/heartbeat.c src/timer_fix.c
                           src/hal_r5_timer.c src/hal_r5_${R5CAP_SPI}.c src/capture_main.c src/icache.c src/fastmem.c src/fatal.c
                           ${CMAKE_CURRENT_SOURCE_DIR}/../fw/capture.c
                           ${CMAKE_CURRENT_SOURCE_DIR}/../fw/mcp3208.c)
target_include_directories(app PRIVATE ${CMAKE_CURRENT_SOURCE_DIR}/../include ${CMAKE_CURRENT_SOURCE_DIR}/../fw)
# The bit-banged build can start sampling on its own (no peripheral to power);
# the McSPI build waits for "r5cap start" after the board script checks MCU_SPI0.
# Sampling code and variables in fast internal memory (TCM, fw/r5cap_fastmem.h).
# Board result: clean rate 16,000 -> 20,000 frames/s. Default on.
option(R5CAP_FASTMEM "Put the sampling code and variables in the R5 TCM" ON)
if(R5CAP_FASTMEM)
  target_compile_definitions(app PRIVATE R5CAP_USE_FASTMEM=1)
  zephyr_linker_sources(SECTIONS r5fast.ld)
endif()
if(R5CAP_SPI STREQUAL "gpio")
  target_compile_definitions(app PRIVATE AUTOSTART_RATE_HZ=4000)
endif()
```

## prj.conf
```kconfig
CONFIG_KERNEL_BIN_NAME="r5capture"
CONFIG_PRINTK=n
CONFIG_IPM=y
CONFIG_MAIN_STACK_SIZE=1024
CONFIG_HEAP_MEM_POOL_SIZE=1024
CONFIG_OPENAMP=y
CONFIG_OPENAMP_RSC_TABLE_NUM_RPMSG_BUFF=8
CONFIG_OPENAMP_RSC_TABLE=y
CONFIG_OPENAMP_MASTER=n

CONFIG_SHELL=y
CONFIG_SHELL_BACKEND_RPMSG=y

# r5capture: do NOT enable CONFIG_CACHE_MANAGEMENT. On this SoC it makes the boot
# code turn the R5 data cache on, but only DRAM gets an MPU region, so device
# registers (timer, mailbox) can be read from stale cache: the firmware stalls
# (heartbeat stuck at 0, no RPMsg channels). Verified on the board 2026-11-25.

# Debugging over the RPMsg shell: "kernel thread list" shows every thread and its state
CONFIG_THREAD_MONITOR=y
CONFIG_THREAD_NAME=y
CONFIG_THREAD_STACK_INFO=y
```

## boards/beagley_ai_j722s_mcu_r5f0_0.overlay
```dts
/*
 * r5capture firmware on the BeagleY-AI MCU R5F.
 *
 * The board gives Zephyr 14 MB of DRAM at 0xa1200000 (up to 0xa2000000, the
 * end of the MCU R5F's carve-out). Keep the top 1 MB for the r5capture shared
 * region (r5cap_heartbeat.h / r5cap_shared.h): Zephyr gets 13 MB, so nothing
 * it links or allocates can land in 0xa1f00000-0xa2000000.
 */

&ddr1 {
	reg = <0xa1200000 DT_SIZE_M(13)>;
};

/ {
	r5cap_shm: memory@a1f00000 {
		compatible = "mmio-sram";
		reg = <0xa1f00000 DT_SIZE_M(1)>;
	};
};
```

## src/capture_main.c
```c
// capture_main.c
// Runs the capture core (fw/capture.c) on the R5: samples MCP3208 ch0 and ch1
// every frame period into the shared-memory ring at R5CAP_SHM_PHYS, which Linux
// reads with linux/r5cap_ring_read (via linux/r5cap_reader.c).
//
// Control: linux/r5cap_ctl writes commands into shared memory (r5cap_control.h),
// checked once per block; the shell commands below work while capture is stopped.
// Autostart: the bit-banged build starts at AUTOSTART_RATE_HZ; the McSPI build
// waits for "r5cap start" (the board script first checks MCU_SPI0 is powered:
// touching an unpowered module can fault the R5).
// Zephyr shell over RPMsg (/dev/ttyRPMSG0):
//   r5cap start [frames_per_s]   (re)start capture; resets the ring
//   r5cap stop
//   r5cap stats                  ring header: state, blocks, late ticks, ADC errors
//   r5cap spiclk <hz>            set the SPI clock (McSPI build; capture stopped)
//   r5cap spitest                time conversions, measure the real SPI clock (stopped)
//
// Frame timing: a busy-wait on the 25 MHz system timer (simplest first version;
// a hardware timer interrupt can replace it later without touching capture.c).
// The thread runs at the lowest preemptible priority and never yields while
// sampling: RPMsg (cooperative) preempts it only when Linux sends something, the
// heartbeat is paused, and the shell (same priority) only runs while capture is
// stopped. While sampling, control it from Linux with linux/r5cap_ctl (shared memory). Anything that delays a frame by more
// than half a period is counted by capture.c as a late tick and flags the block.
// (A k_yield() per block cost a context switch each time: ~1 late frame per 3 blocks
// above 14,000 frames/s on the board.)
#include "capture.h"
#include "hal_r5_spi.h"
#include "mcp3208.h"
#include "r5_hal.h"
#include "r5cap_fastmem.h"
#include "r5cap_control.h"
#include "r5cap_heartbeat.h"
#include <zephyr/sys/barrier.h>
#include <zephyr/init.h>
#include <zephyr/irq.h>
#include <zephyr/kernel.h>
#include <zephyr/shell/shell.h>
#include <zephyr/sys/atomic.h>
#include <stdlib.h>

#define DEFAULT_RATE_HZ 16000
#define MAX_RATE_HZ 40000
#ifndef AUTOSTART_RATE_HZ
#define AUTOSTART_RATE_HZ 0          // set by CMakeLists.txt: 4000 for the gpio build
#endif
#define WORD19_BITS 19
#define BLOCK_FRAMES 128
#define RING_BLOCKS 256
#define CAPTURE_STACK_SIZE 2048
#define CAPTURE_PRIORITY 14          // lowest preemptible, same as the shell: while sampling the
                                     // loop never yields, so use r5cap_ctl (shared memory) then
#define IDLE_POLL_MS 10
#define INIT_RETRY_MS 1000
#define SPITEST_CONVERSIONS 200

// Ring at the start of the shared region; the heartbeat keeps the last 4 KB
#define RING_BYTES (R5CAP_HEARTBEAT_PHYS - R5CAP_SHM_PHYS)
static uint8_t *const ring = (uint8_t *)R5CAP_SHM_PHYS;
BUILD_ASSERT(R5CAP_HEADER_SIZE + RING_BLOCKS * (16 + BLOCK_FRAMES * 2 * 2) <= RING_BYTES,
             "ring doesn't fit in the shared region");

static atomic_t requestedRate = ATOMIC_INIT(AUTOSTART_RATE_HZ);   // 0 = stopped
static uint32_t spiClockHz = 0;   // last clock set with "r5cap spiclk" (0 = HAL default)
static atomic_t capturing = ATOMIC_INIT(0);

uint32_t R5_icacheStatus(void);   // icache.c
extern const k_tid_t heartbeat_tid;   // heartbeat.c

// Anything else that wakes up on the R5 while sampling (here: the heartbeat,
// 10 times a second, plus the timer interrupt for its sleep) delays frames.
// Measured: ~11 late frames/s at every rate. So pause it while capturing; the
// ring's writeSeq shows the R5 is alive. With nothing scheduled, the tickless
// kernel has no timer interrupts at all.
static void pauseBackgroundWork(bool pause)
{
    if (pause) {
        k_thread_suspend(heartbeat_tid);
    } else {
        k_thread_resume(heartbeat_tid);
    }
}

// ---- Control from Linux through shared memory (r5cap_control.h) ----
static volatile struct r5cap_control *const control = (struct r5cap_control *)R5CAP_CONTROL_PHYS;
static volatile struct r5cap_diag *const diag = (struct r5cap_diag *)R5CAP_DIAG_PHYS;
static R5CAP_FAST_DATA uint32_t controlSeqSeen = 0;
static R5CAP_FAST_DATA uint32_t captureFlags = 0;   // R5CAP_CTL_* in effect

static void controlInit(void)
{
    control->magic = 0;
    control->seq = 0;
    control->rateHz = 0;
    control->spiHz = 0;
    control->ackSeq = 0;
    control->ackSpiHz = 0;
    control->ackRateHz = 0;
    control->flags = 0;
    control->ackFlags = 0;
    controlSeqSeen = 0;
    barrier_dmem_fence_full();
    control->magic = R5CAP_CONTROL_MAGIC;
}

static inline bool controlPending(void)
{
    return control->seq != controlSeqSeen;
}

// Called with capture stopped: apply a new command from Linux, then acknowledge it
static void controlApply(void)
{
    uint32_t seq = control->seq;
    barrier_dmem_fence_full();   // read the command after seeing the new seq
    uint32_t rate = control->rateHz;
    uint32_t spi = control->spiHz;
    captureFlags = control->flags;
    if (spi != 0) {
        uint32_t actual = R5SPI_setClockHz(spi);
        if (actual != 0) {
            spiClockHz = actual;
        }
    }
    atomic_set(&requestedRate, (rate <= MAX_RATE_HZ) ? (atomic_val_t)rate : 0);
    control->ackSpiHz = spiClockHz;
    control->ackRateHz = (uint32_t)atomic_get(&requestedRate);
    control->ackFlags = captureFlags;
    controlSeqSeen = seq;
    barrier_dmem_fence_full();
    control->ackSeq = seq;
}

R5CAP_FAST_CODE static void captureThread(void *unused1, void *unused2, void *unused3)
{
    (void)unused1;
    (void)unused2;
    (void)unused3;

    controlInit();
    for (;;) {
        if (controlPending()) {
            controlApply();
        }
        atomic_val_t rate = atomic_get(&requestedRate);
        if (rate == 0) {
            k_msleep(IDLE_POLL_MS);
            continue;
        }
        const uint32_t period = R5HAL_tickHz() / (uint32_t)rate;
        const struct CaptureConfig config = {
            .numChannels = 2,
            .channels = {0, 1},
            .blockFrames = BLOCK_FRAMES,
            .ringBlocks = RING_BLOCKS,
            .framePeriodTicks = period,
        };
        if (!CAPTURE_init(ring, RING_BYTES, &config)) {
            k_msleep(INIT_RETRY_MS);   // header state shows ERROR
            continue;
        }
        atomic_set(&capturing, 1);
        pauseBackgroundWork(true);

        // Diagnostics: reset for this run
        diag->lateEvents = 0;
        diag->maxOvershootTicks = 0;
        diag->eventCount = 0;
        const uint32_t lateThreshold = period / 2;
        uint32_t maxOvershoot = 0;

        // Optional: no interrupts while sampling. Control is polled from shared
        // memory, so nothing here needs one; RPMsg etc. wait until capture stops.
        const bool lockIrqs = (captureFlags & R5CAP_CTL_IRQ_LOCK) != 0;

        // Optional profile of the first R5CAP_PROFILE_FRAMES frames (sums kept in
        // locals, published at block ends; the probes add a few timer reads per frame)
        bool profiling = (captureFlags & R5CAP_CTL_PROFILE) != 0;
        uint32_t profFrames = 0, profFrameTicks = 0, profTickTicks = 0;
        uint32_t profBlockEnds = 0, profBlockEndTicks = 0, profMaxTick = 0;
        uint64_t profPrevStart = 0;
        diag->profFrames = 0;
        r5spiProfileTicks = 0;
        r5spiProfileShiftTicks = 0;
        r5spiProfileOn = profiling;
        unsigned int irqKey = lockIrqs ? irq_lock() : 0;

        // Hot loop: nothing but waiting for the next frame and sampling it.
        // Commands (shared memory or shell) are checked once per block only.
        uint64_t next = R5HAL_nowTicks();
        uint32_t framesInBlock = 0;
        for (;;) {
            next += period;
            uint64_t now = R5HAL_nowTicks();
            uint32_t missed = 0;
            if (now > next + period) {
                missed = (uint32_t)((now - next) / period);   // whole frame slots lost
                next += (uint64_t)missed * period;            // skip them, keep the schedule
            }
            while (now < next) {
                now = R5HAL_nowTicks();
            }
            uint32_t overshoot = (uint32_t)(now - next);   // how late this frame starts
            if (overshoot > lateThreshold || missed > 0) {
                CAPTURE_markLate(missed);   // slips against the schedule count as late

                uint32_t i = diag->eventCount;
                diag->eventTick[i % R5CAP_DIAG_EVENTS] = (uint32_t)now;
                diag->eventOvershoot[i % R5CAP_DIAG_EVENTS] = overshoot;
                diag->eventCount = i + 1;
                diag->lateEvents = diag->lateEvents + 1;
            }
            if (overshoot > maxOvershoot) {
                maxOvershoot = overshoot;
            }
            CAPTURE_tick();
            if (profiling) {
                uint32_t tick = (uint32_t)(R5HAL_nowTicks() - now);
                if (profPrevStart != 0) {
                    profFrameTicks += (uint32_t)(now - profPrevStart);
                }
                profPrevStart = now;
                profTickTicks += tick;
                profMaxTick = MAX(profMaxTick, tick);
                if (framesInBlock + 1 == BLOCK_FRAMES) {
                    profBlockEnds++;
                    profBlockEndTicks += tick;
                }
                if (++profFrames >= R5CAP_PROFILE_FRAMES) {
                    profiling = false;
                    r5spiProfileOn = false;
                }
            }
            if (++framesInBlock == BLOCK_FRAMES) {
                framesInBlock = 0;
                diag->maxOvershootTicks = maxOvershoot;
                if (profFrames > 0) {
                    diag->profFrameTicks = profFrameTicks;
                    diag->profTickTicks = profTickTicks;
                    diag->profSpiTicks = r5spiProfileTicks;
                    diag->profShiftTicks = r5spiProfileShiftTicks;
                    diag->profBlockEnds = profBlockEnds;
                    diag->profBlockEndTicks = profBlockEndTicks;
                    diag->profMaxTickTicks = profMaxTick;
                    diag->profFrames = profFrames;
                }
                if (controlPending() || atomic_get(&requestedRate) != rate) {
                    break;
                }
            }
        }
        r5spiProfileOn = false;
        if (lockIrqs) {
            irq_unlock(irqKey);
        }
        CAPTURE_stop();
        pauseBackgroundWork(false);
        atomic_set(&capturing, 0);
    }
}

// The capture thread's stack goes in the same fast memory as its variables
// (R5CAP_FAST_DATA: ATCM on the R5): every call in the hot loop pushes and pops
// registers, and in uncached DRAM each of those accesses costs ~150 ns.
Z_KERNEL_STACK_DEFINE_IN(captureStack, CAPTURE_STACK_SIZE, R5CAP_FAST_DATA);
static struct k_thread captureThreadData;

static int startCaptureThread(void)
{
    k_tid_t tid = k_thread_create(&captureThreadData, captureStack,
                                  K_KERNEL_STACK_SIZEOF(captureStack), captureThread, NULL, NULL,
                                  NULL, CAPTURE_PRIORITY, 0, K_NO_WAIT);
    k_thread_name_set(tid, "capture");
    return 0;
}

// After the kernel is up (APPLICATION level); runs once the scheduler starts
SYS_INIT(startCaptureThread, APPLICATION, 99);

static int cmdStart(const struct shell *sh, size_t argc, char **argv)
{
    long rate = (argc > 1) ? strtol(argv[1], NULL, 10) : DEFAULT_RATE_HZ;
    if (rate < 1 || rate > MAX_RATE_HZ) {
        shell_error(sh, "rate must be 1..%d frames/s", MAX_RATE_HZ);
        return -EINVAL;
    }
    atomic_set(&requestedRate, 0);   // force a restart even at the same rate
    while (atomic_get(&capturing)) {
        k_msleep(1);
    }
    atomic_set(&requestedRate, rate);
    shell_print(sh, "capture starting at %ld frames/s per mic", rate);
    return 0;
}

static int cmdStop(const struct shell *sh, size_t argc, char **argv)
{
    (void)argc;
    (void)argv;
    atomic_set(&requestedRate, 0);
    shell_print(sh, "capture stopping");
    return 0;
}

static int cmdStats(const struct shell *sh, size_t argc, char **argv)
{
    (void)argc;
    (void)argv;
    const struct r5cap_header *h = (const struct r5cap_header *)ring;
    uint32_t sctlr = R5_icacheStatus();
    shell_print(sh, "spi=%s clock=%u Hz (0 = default)  I-cache=%s D-cache=%s", R5SPI_name(),
                (unsigned int)spiClockHz, (sctlr & BIT(12)) ? "on" : "off", (sctlr & BIT(2)) ? "on" : "off");
    shell_print(sh, "ring @0x%08x state=%u writeSeq=%u lateTicks=%u adcErrors=%u",
                (unsigned int)R5CAP_SHM_PHYS, (unsigned int)h->state, (unsigned int)h->writeSeq,
                (unsigned int)h->lateTicks, (unsigned int)h->adcErrors);
    shell_print(sh, "  %u frames/block, %u blocks, period %u ticks @ %u Hz, ch1 offset %u ticks",
                (unsigned int)h->blockFrames, (unsigned int)h->ringBlocks,
                (unsigned int)h->framePeriodTicks, (unsigned int)h->tickHz,
                (unsigned int)h->channelOffsetTicks[1]);
    return 0;
}

static bool isStopped(const struct shell *sh)
{
    if (atomic_get(&requestedRate) != 0 || atomic_get(&capturing)) {
        shell_error(sh, "stop capture first (r5cap stop)");
        return false;
    }
    return true;
}

static int cmdSpiclk(const struct shell *sh, size_t argc, char **argv)
{
    if (argc < 2 || !isStopped(sh)) {
        return -EINVAL;
    }
    uint32_t actual = R5SPI_setClockHz((uint32_t)strtoul(argv[1], NULL, 10));
    if (actual == 0) {
        shell_error(sh, "%s SPI: clock not adjustable or invalid", R5SPI_name());
        return -EINVAL;
    }
    spiClockHz = actual;
    shell_print(sh, "%s SPI clock set to %u Hz (divider result)", R5SPI_name(), (unsigned int)actual);
    return 0;
}

static int cmdSpitest(const struct shell *sh, size_t argc, char **argv)
{
    (void)argc;
    (void)argv;
    if (!isStopped(sh)) {
        return -EBUSY;
    }
    const double usPerTick = 1e6 / R5HAL_tickHz();
    double frameUs = 0.0;   // both conversions, back to back
    for (uint8_t ch = 0; ch < 2; ch++) {
        uint32_t minValue = MCP3208_MAX_READING, maxValue = 0, sum = 0;
        uint64_t shiftSum = 0, totalSum = 0;
        int ok = 0;
        for (int i = 0; i < SPITEST_CONVERSIONS; i++) {
            uint16_t v;
            uint32_t shift, total;
            if (!R5SPI_measure(ch, &v, &shift, &total)) {
                continue;
            }
            ok++;
            sum += v;
            shiftSum += shift;
            totalSum += total;
            minValue = MIN(minValue, v);
            maxValue = MAX(maxValue, v);
        }
        if (ok == 0) {
            shell_error(sh, "ch%u: all conversions failed", ch);
            continue;
        }
        double shiftUs = shiftSum * usPerTick / ok;
        double totalUs = totalSum * usPerTick / ok;
        frameUs += totalUs;
        shell_print(sh, "ch%u [%s]: %d.%02d us per conversion (shift %d.%02d us -> SPI ~%d kHz for 19 bits);"
                    " values min %u mean %u max %u", ch, R5SPI_name(),
                    (int)totalUs, (int)(totalUs * 100) % 100, (int)shiftUs, (int)(shiftUs * 100) % 100,
                    (int)(WORD19_BITS * 1000.0 / shiftUs), (unsigned int)minValue,
                    (unsigned int)(sum / ok), (unsigned int)maxValue);
    }
    if (frameUs > 0.0) {
        shell_print(sh, "one frame (2 conversions) takes %d.%02d us -> at most ~%d frames/s with no margin",
                    (int)frameUs, (int)(frameUs * 100) % 100, (int)(1e6 / frameUs));
    }
    return 0;
}

SHELL_STATIC_SUBCMD_SET_CREATE(r5capCommands,
    SHELL_CMD(start, NULL, "start [frames_per_s]: (re)start capture", cmdStart),
    SHELL_CMD(stop, NULL, "stop capture", cmdStop),
    SHELL_CMD(stats, NULL, "show the ring header", cmdStats),
    SHELL_CMD(spiclk, NULL, "spiclk <hz>: set the SPI clock (capture must be stopped)", cmdSpiclk),
    SHELL_CMD(spitest, NULL, "time ADC conversions, measure SPI clock (capture stopped)", cmdSpitest),
    SHELL_SUBCMD_SET_END);
SHELL_CMD_REGISTER(r5cap, &r5capCommands, "r5capture sampling", NULL);
```

## src/fastmem.c
```c
// fastmem.c
// Zero the .r5fast section (ATCM, see r5fast.ld and fw/r5cap_fastmem.h) at boot,
// before anything uses it. It's NOLOAD, so it starts with whatever was in the memory.
#include <stdint.h>
#include <string.h>
#include <zephyr/init.h>

extern char __r5fast_start[];
extern char __r5fast_end[];

static int zeroFastData(void)
{
    memset(__r5fast_start, 0, (size_t)(__r5fast_end - __r5fast_start));
    return 0;
}

// EARLY, priority 0: before the kernel, drivers and every thread
SYS_INIT(zeroFastData, EARLY, 0);
```

## src/fatal.c
```c
// fatal.c
// On any fatal error (data abort, assert, ...) record why in shared memory
// (struct r5cap_crash, r5cap_control.h) so Linux can read it with
// "r5cap_ctl crash", then halt. Without this, a crash just looks like "the R5
// stopped answering". Look up the PC with:
//   arm-zephyr-eabi-addr2line -e r5capture.elf -f <pc>
#include "r5cap_control.h"
#include <zephyr/arch/cpu.h>
#include <zephyr/fatal.h>
#include <zephyr/init.h>
#include <zephyr/irq.h>
#include <zephyr/sys/barrier.h>

static volatile struct r5cap_crash *const crash = (struct r5cap_crash *)R5CAP_CRASH_PHYS;

static inline uint32_t readCp15(int which)
{
    uint32_t v = 0;
    switch (which) {
    case 0: __asm__ volatile("mrc p15, 0, %0, c5, c0, 0" : "=r"(v)); break;  // DFSR
    case 1: __asm__ volatile("mrc p15, 0, %0, c6, c0, 0" : "=r"(v)); break;  // DFAR
    case 2: __asm__ volatile("mrc p15, 0, %0, c5, c0, 1" : "=r"(v)); break;  // IFSR
    default: __asm__ volatile("mrc p15, 0, %0, c6, c0, 2" : "=r"(v)); break; // IFAR
    }
    return v;
}

void k_sys_fatal_error_handler(unsigned int reason, const struct arch_esf *esf)
{
    (void)irq_lock();
    crash->reason = reason;
    crash->pc = (esf != NULL) ? esf->basic.pc : 0;
    crash->lr = (esf != NULL) ? esf->basic.lr : 0;
    crash->r0 = (esf != NULL) ? esf->basic.r0 : 0;
    crash->xpsr = (esf != NULL) ? esf->basic.xpsr : 0;
    crash->dfsr = readCp15(0);
    crash->dfar = readCp15(1);
    crash->ifsr = readCp15(2);
    crash->ifar = readCp15(3);
    barrier_dmem_fence_full();
    crash->magic = R5CAP_CRASH_MAGIC;
    for (;;) {
    }
}

static int clearCrashRecord(void)
{
    crash->magic = 0;
    return 0;
}

SYS_INIT(clearCrashRecord, EARLY, 1);
```

## src/hal_r5_gpio.c
```c
// hal_r5_gpio.c
// R5HAL_spiTransfer() for fw/r5_hal.h, bit-banged (build option R5CAP_SPI=gpio).
// Measured: ~100 us per 24-bit conversion (each R5 register access ~0.7 us),
// so it tops out around 4,500 frames/s. Kept as a fallback; hal_r5_mcspi.c is
// the fast version.
//
// SPI: bit-banged on MCU_GPIO0, on the pins Linux's course overlay (spidev0,
// spi-gpio) already set up as GPIOs, so nothing on the Linux side changes:
//   CS0 = bit 0 (header 24), SCLK = bit 2 (23), MOSI = bit 3 (19), MISO = bit 4 (21).
// Linux has already set the directions (CS/SCLK/MOSI out, MISO in) and the pad
// muxing. We only use the per-bit SET/CLR registers (no read-modify-write), so
// we never disturb other pins of the bank. Linux must not use /dev/spidev0.x
// while the R5 samples (both would drive the same pins).
//
// Mode 0 (clock idles low, data read on the rising edge), MSB first. The clock
// is timed from the system timer so it stays at or below the MCP3208's 1 MHz
// rating at 2.7 V; HALF_PERIOD_TICKS sets it.
#include "r5_hal.h"
#include <zephyr/arch/cpu.h>
#include <zephyr/devicetree.h>
#include <zephyr/sys/sys_io.h>
#include <zephyr/sys/util.h>

// MCU_GPIO0 bank 0 registers (Zephyr's gpio_davinci.c layout), base from the device tree
#define GPIO_BASE DT_REG_ADDR(DT_NODELABEL(mcu_gpio0))
#define GPIO_SET_DATA (GPIO_BASE + 0x08)
#define GPIO_CLR_DATA (GPIO_BASE + 0x0c)
#define GPIO_IN_DATA (GPIO_BASE + 0x10)

#define PIN_CS BIT(0)
#define PIN_SCLK BIT(2)
#define PIN_MOSI BIT(3)
#define PIN_MISO BIT(4)

// System timer: free-running counter
#define TIMER_TCRR (DT_REG_ADDR(DT_CHOSEN(zephyr_system_timer)) + 0x3c)

// 13 ticks = 520 ns half period -> ~0.96 MHz SPI clock (MCP3208: 1 MHz at 2.7 V)
#ifndef HALF_PERIOD_TICKS
#define HALF_PERIOD_TICKS 13u
#endif


static inline uint32_t counterNow(void)
{
    return sys_read32(TIMER_TCRR);
}

static inline void waitHalfPeriod(uint32_t *edge)
{
    // Wait until HALF_PERIOD_TICKS after the previous edge (not after this call),
    // so the time spent in GPIO writes counts toward the half period
    while ((uint32_t)(counterNow() - *edge) < HALF_PERIOD_TICKS) {
    }
    *edge += HALF_PERIOD_TICKS;
}

bool R5HAL_spiTransfer(const uint8_t *tx, uint8_t *rx, uint32_t len)
{
    if (tx == NULL || rx == NULL) {
        return false;
    }
    uint32_t edge = counterNow();
    sys_write32(PIN_SCLK, GPIO_CLR_DATA);   // mode 0: clock idles low
    sys_write32(PIN_CS, GPIO_CLR_DATA);     // select the ADC
    waitHalfPeriod(&edge);

    for (uint32_t i = 0; i < len; i++) {
        uint8_t in = 0;
        for (int bit = 7; bit >= 0; bit--) {   // MSB first
            sys_write32(PIN_MOSI, ((tx[i] >> bit) & 1) ? GPIO_SET_DATA : GPIO_CLR_DATA);
            waitHalfPeriod(&edge);
            sys_write32(PIN_SCLK, GPIO_SET_DATA);           // rising edge: both sides sample
            if ((sys_read32(GPIO_IN_DATA) & PIN_MISO) != 0) {
                in |= (uint8_t)(1u << bit);
            }
            waitHalfPeriod(&edge);
            sys_write32(PIN_SCLK, GPIO_CLR_DATA);           // falling edge: ADC shifts out next bit
        }
        rx[i] = in;
    }

    sys_write32(PIN_CS, GPIO_SET_DATA);     // deselect: ends the conversion
    waitHalfPeriod(&edge);                  // CS high time before the next conversion
    return true;
}

// ---- Extra controls (hal_r5_spi.h) ----
#include "hal_r5_spi.h"
#include "mcp3208.h"

volatile bool r5spiProfileOn = false;   // not implemented for the bit-banged SPI
uint32_t r5spiProfileTicks = 0;
uint32_t r5spiProfileShiftTicks = 0;

const char *R5SPI_name(void)
{
    return "gpio";
}

uint32_t R5SPI_setClockHz(uint32_t hz)
{
    (void)hz;
    return 0;   // fixed by HALF_PERIOD_TICKS and register access time
}

bool R5SPI_measure(uint8_t channel, uint16_t *value, uint32_t *shiftTicks, uint32_t *totalTicks)
{
    uint8_t tx[MCP3208_TRANSFER_BYTES];
    uint8_t rx[MCP3208_TRANSFER_BYTES];
    if (!MCP3208_encodeCommand(channel, tx)) {
        return false;
    }
    uint64_t begin = R5HAL_nowTicks();
    bool ok = R5HAL_spiTransfer(tx, rx, MCP3208_TRANSFER_BYTES);
    *totalTicks = (uint32_t)(R5HAL_nowTicks() - begin);
    *shiftTicks = *totalTicks;
    *value = MCP3208_decodeResult(rx);
    return ok;
}
```

## src/hal_r5_mcspi.c
```c
// hal_r5_mcspi.c
// R5HAL_spiTransfer() for fw/r5_hal.h using the MCU_SPI0 hardware controller
// (build option R5CAP_SPI=mcspi, the default). The controller shifts the bits,
// so a conversion costs ~5 register accesses instead of ~150 when bit-banging.
//
// Board requirements (board/setup_mcspi_overlay.sh, board/mcspi_power_on.sh):
//   - Linux boots with Joey's MCU_SPI0 overlay: the ADC pads are muxed to MCU_SPI0
//     (D0 = MOSI out, D1 = MISO in) instead of GPIO.
//   - Linux keeps MCU_SPI0 powered and clocked (power/control = "on"). Touching an
//     unpowered module can fault the R5, so the board script checks this first.
//   - Linux must not use the SPI device while the R5 samples.
//
// MCP3208 word: the 3-byte command from fw/mcp3208.c starts with 5 zero bits,
// which the ADC ignores (nothing happens before the start bit). So the 24-bit
// transfer is sent as one 19-bit word, the minimum for a conversion: same
// result bits in the same positions, 21 % fewer clocks.
//
// Register map and bit fields: Zephyr's drivers/spi/spi_omap_mcspi.c.
#include "hal_r5_spi.h"
#include "r5_hal.h"
#include "r5cap_fastmem.h"
#include <zephyr/arch/cpu.h>
#include <zephyr/sys/sys_io.h>
#include <zephyr/sys/util.h>

// MCU_SPI0 base (AM62x/J722S MCU domain). The board script checks Linux's device
// path (spi@4b00000) matches before this firmware is loaded.
#ifndef MCSPI_BASE
#define MCSPI_BASE 0x04B00000u
#endif
// Functional (reference) clock of the controller (48 MHz). R5SPI_measure() reports the
// real SPI clock, so a wrong value here shows up immediately.
#ifndef MCSPI_REF_HZ
#define MCSPI_REF_HZ 48000000u   // measured on the board: shift times at two dividers -> ~48.7 MHz
#endif
#ifndef MCSPI_DEFAULT_HZ
#define MCSPI_DEFAULT_HZ 1000000u   // MCP3208: 1 MHz guaranteed at 2.7 V
#endif

#define REG_SYSCONFIG (MCSPI_BASE + 0x110)
#define REG_SYSSTATUS (MCSPI_BASE + 0x114)
#define REG_MODULCTRL (MCSPI_BASE + 0x128)
#define REG_CH0CONF (MCSPI_BASE + 0x12c)
#define REG_CH0STAT (MCSPI_BASE + 0x130)
#define REG_CH0CTRL (MCSPI_BASE + 0x134)
#define REG_TX0 (MCSPI_BASE + 0x138)
#define REG_RX0 (MCSPI_BASE + 0x13c)

#define SYSCONFIG_SOFTRESET BIT(1)
#define SYSSTATUS_RESETDONE BIT(0)
#define MODULCTRL_SINGLE BIT(0)      // single channel, controller mode, CS by FORCE
#define CHCONF_PHA BIT(0)
#define CHCONF_POL BIT(1)
#define CHCONF_CLKD_SHIFT 2          // 4 bits
#define CHCONF_EPOL BIT(6)           // CS active low
#define CHCONF_WL_SHIFT 7            // word length - 1, 5 bits
#define CHCONF_DPE0 BIT(16)          // 1 = don't transmit on D0
#define CHCONF_DPE1 BIT(17)          // 1 = don't transmit on D1
#define CHCONF_IS BIT(18)            // 1 = receive on D1
#define CHCONF_FORCE BIT(20)         // assert CS
#define CHCONF_CLKG BIT(29)          // divider granularity 1 (uses EXTCLK)
#define CHCTRL_EN BIT(0)
#define CHCTRL_EXTCLK_SHIFT 8        // 8 bits
#define CHSTAT_RXS BIT(0)

#define WORD_BITS 19u
#define WORD_MASK ((1u << WORD_BITS) - 1u)
#define LEADING_ZERO_MASK 0xF80000u  // the 5 bits dropped from the 24-bit command
#define MAX_RATIO 4096u
#define RESET_WAIT_LOOPS 100000
#define TRANSFER_TIMEOUT_TICKS 25000u    // 1 ms: never hang the R5 on a stuck transfer
#define TRANSFER_FAILED 0xFFFFFFFFu      // more than 19 bits, so never a real reply

// MCP3208: CS must stay high at least 500 ns between conversions (tCSH)
#define CS_HIGH_TICKS 14u   // 560 ns at 25 MHz

R5CAP_FAST_DATA volatile bool r5spiProfileOn = false;
R5CAP_FAST_DATA uint32_t r5spiProfileTicks = 0;
R5CAP_FAST_DATA uint32_t r5spiProfileShiftTicks = 0;

static R5CAP_FAST_DATA bool isReady = false;
static R5CAP_FAST_DATA uint32_t chconf = 0;   // CH0CONF without FORCE (kept here to avoid read-modify-write)
static R5CAP_FAST_DATA uint32_t clockHz = 0;
static R5CAP_FAST_DATA uint64_t csHighTick = 0;   // when CS last went high

const char *R5SPI_name(void)
{
    return "mcspi";
}

// Program the divider: SPI clock = MCSPI_REF_HZ / ratio (granularity 1)
static void applyClock(uint32_t hz)
{
    uint32_t ratio = DIV_ROUND_UP(MCSPI_REF_HZ, hz);
    ratio = CLAMP(ratio, 1u, MAX_RATIO);
    chconf = (chconf & ~(0xFu << CHCONF_CLKD_SHIFT)) | (((ratio - 1) & 0xF) << CHCONF_CLKD_SHIFT) |
             CHCONF_CLKG;
    sys_write32(0, REG_CH0CTRL);   // disable while reconfiguring
    sys_write32(chconf, REG_CH0CONF);
    sys_write32((((ratio - 1) >> 4) << CHCTRL_EXTCLK_SHIFT) | CHCTRL_EN, REG_CH0CTRL);
    clockHz = MCSPI_REF_HZ / ratio;
}

static bool init(void)
{
    sys_write32(SYSCONFIG_SOFTRESET, REG_SYSCONFIG);
    for (int i = 0; (sys_read32(REG_SYSSTATUS) & SYSSTATUS_RESETDONE) == 0; i++) {
        if (i >= RESET_WAIT_LOOPS) {
            return false;
        }
    }
    sys_write32(MODULCTRL_SINGLE, REG_MODULCTRL);
    // Mode 0, CS active low, 19-bit words, transmit on D0 only, receive on D1
    chconf = CHCONF_EPOL | ((WORD_BITS - 1) << CHCONF_WL_SHIFT) | CHCONF_DPE1 | CHCONF_IS;
    applyClock(clockHz != 0 ? clockHz : MCSPI_DEFAULT_HZ);
    isReady = true;
    return true;
}

uint32_t R5SPI_setClockHz(uint32_t hz)
{
    if (hz == 0 || (!isReady && !init())) {
        return 0;
    }
    applyClock(hz);
    return clockHz;
}

// One 19-bit word, CS asserted around it. Returns the received word, or
// TRANSFER_FAILED if the controller never finished.
R5CAP_FAST_CODE static inline uint32_t transferWord(uint32_t word, uint32_t *shiftTicks, uint64_t *startTick)
{
    while (R5HAL_nowTicks() - csHighTick < CS_HIGH_TICKS) {
    }
    sys_write32(chconf | CHCONF_FORCE, REG_CH0CONF);   // CS low
    // Let the CS change reach the controller before loading the word. Without a gap
    // here the word is never shifted out (seen on the board once this code ran from
    // TCM). The timer read also covers tSUCS (100 ns).
    (void)sys_read32(REG_CH0CONF);
    const uint64_t start = R5HAL_nowTicks();
    if (startTick != NULL) {
        *startTick = start;
    }
    sys_write32(word, REG_TX0);
    while ((sys_read32(REG_CH0STAT) & CHSTAT_RXS) == 0) {
        if (R5HAL_nowTicks() - start > TRANSFER_TIMEOUT_TICKS) {
            sys_write32(chconf, REG_CH0CONF);
            isReady = false;   // reset the controller before the next transfer
            return TRANSFER_FAILED;
        }
    }
    if (shiftTicks != NULL) {
        *shiftTicks = (uint32_t)(R5HAL_nowTicks() - *startTick);
    }
    uint32_t rx = sys_read32(REG_RX0) & WORD_MASK;
    sys_write32(chconf, REG_CH0CONF);                  // CS high: ends the conversion
    (void)sys_read32(REG_CH0CONF);                     // wait until the write has arrived
    csHighTick = R5HAL_nowTicks();
    return rx;
}

R5CAP_FAST_CODE bool R5HAL_spiTransfer(const uint8_t *tx, uint8_t *rx, uint32_t len)
{
    if (tx == NULL || rx == NULL || len != 3 || (!isReady && !init())) {
        return false;
    }
    uint32_t command = ((uint32_t)tx[0] << 16) | ((uint32_t)tx[1] << 8) | tx[2];
    if ((command & LEADING_ZERO_MASK) != 0) {
        return false;   // only MCP3208-style commands (5 leading zeros) can be shortened
    }
    uint32_t reply;
    if (r5spiProfileOn) {
        uint64_t begin = R5HAL_nowTicks();
        uint64_t shiftStart = 0;
        uint32_t shift = 0;
        reply = transferWord(command & WORD_MASK, &shift, &shiftStart);
        r5spiProfileTicks += (uint32_t)(R5HAL_nowTicks() - begin);
        r5spiProfileShiftTicks += shift;
    } else {
        reply = transferWord(command & WORD_MASK, NULL, NULL);
    }
    if (reply == TRANSFER_FAILED) {
        return false;
    }
    rx[0] = 0;
    rx[1] = (uint8_t)(reply >> 8);
    rx[2] = (uint8_t)reply;
    return true;
}

bool R5SPI_measure(uint8_t channel, uint16_t *value, uint32_t *shiftTicks, uint32_t *totalTicks)
{
    if (channel > 7 || (!isReady && !init())) {
        return false;
    }
    // START | SGL | channel: the same bits fw/mcp3208.c sends, minus the 5 leading zeros
    uint32_t word = (1u << 18) | (1u << 17) | ((uint32_t)channel << 14);
    uint64_t begin = R5HAL_nowTicks();
    uint64_t shiftStart = 0;
    uint32_t reply = transferWord(word, shiftTicks, &shiftStart);
    if (reply == TRANSFER_FAILED) {
        return false;
    }
    *totalTicks = (uint32_t)(R5HAL_nowTicks() - begin);
    *value = (uint16_t)(reply & 0xFFF);
    return true;
}
```

## src/hal_r5_spi.h
```c
// hal_r5_spi.h
// Extra SPI controls for the shell and diagnostics, beyond fw/r5_hal.h.
// Implemented by whichever SPI HAL is built (hal_r5_mcspi.c or hal_r5_gpio.c).
#ifndef HAL_R5_SPI_H
#define HAL_R5_SPI_H

#include <stdbool.h>
#include <stdint.h>

// Short name of the SPI implementation ("mcspi" or "gpio")
const char *R5SPI_name(void);

// Ask for an SPI clock. Returns the clock actually set (from the divider), or 0
// if not supported. Only call while capture is stopped.
uint32_t R5SPI_setClockHz(uint32_t hz);

// One conversion of channel, measuring the time spent shifting bits (from the
// TX write to the RX word being ready) and the whole transfer, in timer ticks.
bool R5SPI_measure(uint8_t channel, uint16_t *value, uint32_t *shiftTicks, uint32_t *totalTicks);

// Profiling (capture_main.c): while r5spiProfileOn, R5HAL_spiTransfer() adds the
// time it takes, and the bit-shifting part of it, to these sums (timer ticks).
extern volatile bool r5spiProfileOn;
extern uint32_t r5spiProfileTicks;
extern uint32_t r5spiProfileShiftTicks;

#endif
```

## src/hal_r5_timer.c
```c
// hal_r5_timer.c
// R5HAL_nowTicks() / R5HAL_tickHz() for fw/r5_hal.h: the system timer
// (MCU_TIMER0, 25 MHz, 32-bit, free-running) extended to 64 bits.
// Only the capture thread calls these, so no locking.
#include "r5_hal.h"
#include "r5cap_fastmem.h"
#include <zephyr/arch/cpu.h>
#include <zephyr/devicetree.h>
#include <zephyr/sys/sys_io.h>

#define TIMER_TCRR (DT_REG_ADDR(DT_CHOSEN(zephyr_system_timer)) + 0x3c)
#define TIMER_HZ 25000000u   // measured on the board (25,050 counts per 1 ms busy-wait)

static R5CAP_FAST_DATA uint32_t lastLow = 0;
static R5CAP_FAST_DATA uint64_t high = 0;

R5CAP_FAST_CODE uint64_t R5HAL_nowTicks(void)
{
    uint32_t low = sys_read32(TIMER_TCRR);
    if (low < lastLow) {
        high += 1ull << 32;   // the 32-bit counter wrapped (every ~172 s)
    }
    lastLow = low;
    return high | low;
}

uint32_t R5HAL_tickHz(void)
{
    return TIMER_HZ;
}
```

## src/heartbeat.c
```c
// heartbeat.c
// Writes struct r5cap_heartbeat (r5cap_heartbeat.h) into the shared region
// every R5CAP_HEARTBEAT_PERIOD_MS, so Linux can see this firmware is running.
// Also adds an "r5hb" command to the Zephyr shell over RPMsg (/dev/ttyRPMSG*).
//
// Caching: the R5's data cache is OFF in this firmware (CONFIG_CACHE_MANAGEMENT
// is not set, so the SoC boot code never enables it; see prj.conf for why it
// must stay off). Writes therefore go straight to DRAM. publish() still has a
// barrier for ordering, and a cache flush that is a no-op today but keeps this
// correct if the cache is ever enabled with a proper MPU setup.
#include "r5cap_heartbeat.h"
#include <zephyr/cache.h>
#include <zephyr/devicetree.h>
#include <zephyr/kernel.h>
#include <zephyr/shell/shell.h>
#include <zephyr/irq.h>
#include <zephyr/sys/barrier.h>
#include <zephyr/sys/sys_io.h>

#define SHM_NODE DT_NODELABEL(r5cap_shm)
BUILD_ASSERT(DT_REG_ADDR(SHM_NODE) == R5CAP_SHM_PHYS,
             "r5cap_shm in the board overlay must match R5CAP_SHM_PHYS");
BUILD_ASSERT(DT_REG_SIZE(SHM_NODE) == R5CAP_SHM_SIZE,
             "r5cap_shm in the board overlay must match R5CAP_SHM_SIZE");

#define HEARTBEAT_STACK_SIZE 1024
#define HEARTBEAT_PRIORITY 7

static struct r5cap_heartbeat *const heartbeat = (struct r5cap_heartbeat *)R5CAP_HEARTBEAT_PHYS;

// Make our writes visible to Linux, in order (see the caching note above)
static void publish(void)
{
    barrier_dmem_fence_full();
    sys_cache_data_flush_range((void *)heartbeat, sizeof(*heartbeat));
}

static void heartbeatThread(void *unused1, void *unused2, void *unused3)
{
    (void)unused1;
    (void)unused2;
    (void)unused3;

    // Old contents may be left over from a previous run: clear first, set magic last
    heartbeat->magic = 0;
    heartbeat->version = R5CAP_HEARTBEAT_VERSION;
    heartbeat->counter = 0;
    heartbeat->uptimeMs = 0;
    publish();
    heartbeat->magic = R5CAP_HEARTBEAT_MAGIC;
    publish();

    for (;;) {
        k_msleep(R5CAP_HEARTBEAT_PERIOD_MS);
        heartbeat->counter++;
        heartbeat->uptimeMs = k_uptime_get_32();
        publish();
    }
}

K_THREAD_DEFINE(heartbeat_tid, HEARTBEAT_STACK_SIZE, heartbeatThread, NULL, NULL, NULL,
                HEARTBEAT_PRIORITY, 0, 0);

static int cmdStatus(const struct shell *sh, size_t argc, char **argv)
{
    (void)argc;
    (void)argv;
    shell_print(sh, "r5capture heartbeat at 0x%08x: magic=0x%08x counter=%u uptime=%u ms",
                (unsigned int)R5CAP_HEARTBEAT_PHYS, (unsigned int)heartbeat->magic,
                (unsigned int)heartbeat->counter, (unsigned int)heartbeat->uptimeMs);
    return 0;
}

SHELL_CMD_REGISTER(r5hb, NULL, "Show r5capture heartbeat status", cmdStatus);

// ---- Debug: system timer (MCU_TIMER0) registers, read directly on the R5 ----
// Offsets from zephyr/drivers/timer/ti_dmtimer.h. Used to find out why sleeps
// never wake (timer counts, but its interrupt doesn't arrive).
#define SYSTIMER_NODE DT_CHOSEN(zephyr_system_timer)
#define SYSTIMER_BASE DT_REG_ADDR(SYSTIMER_NODE)
#define SYSTIMER_IRQ DT_IRQN(SYSTIMER_NODE)
#define REG(offset) sys_read32(SYSTIMER_BASE + (offset))

static int cmdTimer(const struct shell *sh, size_t argc, char **argv)
{
    (void)argc;
    (void)argv;
    uint32_t count1 = REG(0x3c);
    k_busy_wait(1000);
    uint32_t count2 = REG(0x3c);
    shell_print(sh, "system timer @0x%08x irq %u (irq_is_enabled=%d)", (unsigned int)SYSTIMER_BASE,
                (unsigned int)SYSTIMER_IRQ, irq_is_enabled(SYSTIMER_IRQ));
    shell_print(sh, "  TIDR=0x%08x TIOCP_CFG=0x%08x TCLR=0x%08x", REG(0x00), REG(0x10), REG(0x38));
    shell_print(sh, "  IRQSTATUS_RAW=0x%08x IRQSTATUS=0x%08x IRQENABLE=0x%08x", REG(0x24), REG(0x28),
                REG(0x2c));
    shell_print(sh, "  TCRR=0x%08x then 0x%08x after 1 ms busy-wait (delta %u)", count1, count2,
                count2 - count1);
    shell_print(sh, "  TMAR=0x%08x TLDR=0x%08x TWPS=0x%08x TSICR=0x%08x", REG(0x4c), REG(0x40),
                REG(0x48), REG(0x54));
    shell_print(sh, "  uptime=%u ms, kernel ticks=%u", (unsigned int)k_uptime_get_32(),
                (unsigned int)sys_clock_tick_get_32());
    return 0;
}

SHELL_CMD_REGISTER(r5timer, NULL, "Dump the system timer registers (debug)", cmdTimer);
```

## src/icache.c
```c
// icache.c
// Turn on the R5's INSTRUCTION cache only, so code running from DRAM is fast.
//
// Why: this firmware runs from DRAM (0xA1200000) with both caches off, and the
// SoC boot springboard maps all DRAM (MPU region 0) as inner NON-cacheable. So
// every instruction is fetched from DDR. Measured on the board (McSPI build):
// a frame cost ~64 us of which only ~32 us was SPI shifting, capping the R5 at
// ~15,700 frames/s, and slow code made every interruption long enough to make
// frames late.
//
// What: (1) mark MPU region 0 (all of DRAM) inner+outer write-back, so its CODE
// can be cached; (2) invalidate and enable the I-cache (SCTLR.I).
// The DATA cache stays OFF (SCTLR.C = 0), so every data access, including the
// shared ring that Linux reads, still goes straight to DRAM, and device
// registers are unaffected (they're outside region 0). Enabling the data cache
// is what stalled the firmware before (see prj.conf); this doesn't do that.
// Safe for code: remoteproc loads the firmware before the R5 starts, and the
// cache is invalidated before it's enabled.
#include <zephyr/arch/arm/cortex_a_r/cpu.h>
#include <zephyr/arch/arm/cortex_a_r/mpu.h>
#include <zephyr/init.h>
#include <zephyr/sys/util.h>

#define MPU_REGION_DRAM 0   // set up by soc/ti/k3/common/cortex_r/boot.S
// Normal memory, outer and inner write-back write-allocate: TEX=0b001, C=1, B=1
#define DRAM_CACHE_ATTR ((1UL << MPU_RASR_TEX_Pos) | MPU_RASR_C_Msk | MPU_RASR_B_Msk)

// Peripheral registers must be Device memory. Below 0x80000000 the R5's default map is
// Normal memory, where writes to one register may be merged or reordered: with the
// sampling loop in TCM, "CS high" and the next "CS low" can run together. The SoC code only sets up DRAM, so add the two areas we use.
#define MPU_REGION_MCU_PERIPHERALS 6     // timers, MCSPI, VIM
#define MCU_PERIPHERALS_BASE 0x04000000u
#define MCU_PERIPHERALS_SIZE_FIELD 25u   // 2^(25+1) = 64 MB
#define MPU_REGION_MAILBOX 7
#define MAILBOX_BASE 0x29000000u
#define MAILBOX_SIZE_FIELD 19u           // 2^(19+1) = 1 MB
#define DEVICE_ATTR (MPU_RASR_XN_Msk | (3UL << MPU_RASR_AP_Pos) | MPU_RASR_S_Msk | MPU_RASR_B_Msk)

static void setDeviceRegion(uint32_t region, uint32_t base, uint32_t sizeField)
{
    __asm__ volatile("mcr p15, 0, %0, c6, c2, 0" ::"r"(region));                  // RGNR
    __asm__ volatile("isb");
    __asm__ volatile("mcr p15, 0, %0, c6, c1, 0" ::"r"(base));                    // DRBAR
    __asm__ volatile("mcr p15, 0, %0, c6, c1, 4" ::"r"(DEVICE_ATTR));             // DRACR
    __asm__ volatile("mcr p15, 0, %0, c6, c1, 2" ::"r"((sizeField << 1) | 1u));   // DRSR
    __asm__ volatile("dsb; isb" ::: "memory");
}

static inline uint32_t readSctlr(void)
{
    uint32_t v;
    __asm__ volatile("mrc p15, 0, %0, c1, c0, 0" : "=r"(v));
    return v;
}

static int enableInstructionCache(void)
{
    setDeviceRegion(MPU_REGION_MCU_PERIPHERALS, MCU_PERIPHERALS_BASE, MCU_PERIPHERALS_SIZE_FIELD);
    setDeviceRegion(MPU_REGION_MAILBOX, MAILBOX_BASE, MAILBOX_SIZE_FIELD);

    // (1) Region 0 attributes (DRACR): keep access permissions and XN, change the
    //     memory type to cacheable write-back
    uint32_t dracr;
    __asm__ volatile("mcr p15, 0, %0, c6, c2, 0" ::"r"(MPU_REGION_DRAM));   // RGNR
    __asm__ volatile("isb");
    __asm__ volatile("mrc p15, 0, %0, c6, c1, 4" : "=r"(dracr));            // DRACR
    dracr &= ~(MPU_RASR_TEX_Msk | MPU_RASR_C_Msk | MPU_RASR_B_Msk);
    dracr |= DRAM_CACHE_ATTR;
    __asm__ volatile("dsb");
    __asm__ volatile("mcr p15, 0, %0, c6, c1, 4" ::"r"(dracr) : "memory");
    __asm__ volatile("dsb; isb");

    // (2) Invalidate the whole I-cache, then enable it (data cache untouched)
    uint32_t sctlr = readSctlr();
    if ((sctlr & SCTLR_I_BIT) == 0) {
        __asm__ volatile("mcr p15, 0, %0, c7, c5, 0" ::"r"(0) : "memory");    // ICIALLU
        __asm__ volatile("dsb; isb");
        __asm__ volatile("mcr p15, 0, %0, c1, c0, 0" ::"r"(sctlr | SCTLR_I_BIT) : "memory");
        __asm__ volatile("isb");
    }
    return 0;
}

// As early as possible, so the whole boot and everything after runs cached
SYS_INIT(enableInstructionCache, EARLY, 0);

// For the shell: report what's on
uint32_t R5_icacheStatus(void);
uint32_t R5_icacheStatus(void)
{
    return readSctlr();
}
```

## src/timer_fix.c
```c
// timer_fix.c
// Workaround for a bug in Zephyr v4.5.0's TI DM timer driver
// (drivers/timer/ti_dmtimer.c, unchanged on main as of 2026-11-25).
//
// The driver sets TCLR one bit at a time with read-modify-write: AR, then CE
// (compare enable), then ST (start). The DM timer "posts" TCLR writes: they
// complete a little later in the timer's own clock domain, and until then a
// read returns the old value. So the ST step reads TCLR before the CE write
// has landed and writes it back without CE. The timer then counts but never
// raises its match interrupt, and every k_sleep() blocks forever.
// Seen on the BeagleY-AI MCU R5F: TCLR=0x3 (AR|ST, no CE), IRQSTATUS_RAW=0.
//
// Fix: right after the driver's init, wait until no TCLR write is pending and
// set CE again. Should be fixed in the driver itself (wait on TWPS before each
// read-modify-write); then this file can go.
#include <zephyr/arch/cpu.h>
#include <zephyr/devicetree.h>
#include <zephyr/init.h>
#include <zephyr/sys/sys_io.h>
#include <zephyr/sys/util.h>

#define SYSTIMER_BASE DT_REG_ADDR(DT_CHOSEN(zephyr_system_timer))
#define REG_TCLR 0x38
#define REG_TWPS 0x48
#define TCLR_CE BIT(6)          // compare enable
#define TWPS_W_PEND_TCLR BIT(0) // a TCLR write is still being applied

static void waitTclrWrite(void)
{
    while ((sys_read32(SYSTIMER_BASE + REG_TWPS) & TWPS_W_PEND_TCLR) != 0) {
    }
}

static int fixSystemTimerCompare(void)
{
    waitTclrWrite();
    uint32_t tclr = sys_read32(SYSTIMER_BASE + REG_TCLR);
    if ((tclr & TCLR_CE) == 0) {
        sys_write32(tclr | TCLR_CE, SYSTIMER_BASE + REG_TCLR);
        waitTclrWrite();
    }
    return 0;
}

// The driver initializes at PRE_KERNEL_2 / CONFIG_SYSTEM_CLOCK_INIT_PRIORITY;
// run just after it, before any thread can sleep.
BUILD_ASSERT(CONFIG_SYSTEM_CLOCK_INIT_PRIORITY < 1, "must run after the system timer driver");
SYS_INIT(fixSystemTimerCompare, PRE_KERNEL_2, 1);
```
