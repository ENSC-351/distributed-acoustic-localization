## CMakeLists.txt
```
# Heartbeat firmware for the MCU R5F (see ../README.md)
cmake_minimum_required(VERSION 3.20.0)
find_package(Zephyr REQUIRED HINTS $ENV{ZEPHYR_BASE})
project(r5_heartbeat LANGUAGES C)
target_sources(app PRIVATE src/main.c)
zephyr_linker_sources(SECTIONS rsc_table.ld)
```

## prj.conf
```kconfig
# No console: UART1 is on header pins 8/10 and may belong to Linux
CONFIG_SERIAL=n
CONFIG_CONSOLE=n
CONFIG_UART_CONSOLE=n
CONFIG_MAIN_STACK_SIZE=1024

# The tick timer runs from the 25 MHz oscillator (measured against Linux), not
# the SoC default of 19.2 MHz
CONFIG_SYS_CLOCK_HW_CYCLES_PER_SEC=25000000
```

## src/main.c
```c
// Heartbeat for the MCU R5F: counts in shared memory so Linux can see that our
// firmware boots, keeps time, and restarts. Linux side: board/heartbeat_read.c
#include <stdint.h>
#include <zephyr/devicetree.h>
#include <zephyr/init.h>
#include <zephyr/kernel.h>
#include <zephyr/sys/sys_io.h>
#include <zephyr/sys/barrier.h>

#include "../../heartbeat.h"

// remoteproc requires a resource table; this one is empty
struct resource_table {
	uint32_t ver;
	uint32_t num;
	uint32_t reserved[2];
};

__attribute__((section(".resource_table"), used))
const struct resource_table resourceTable = { .ver = 1, .num = 0 };

// The tick timer powers up in posted-write mode, where a register read soon
// after a write returns the old value. Zephyr's driver (4.4.2) then loses the
// compare-enable bit and the tick never fires. Turn posted mode off first.
#define TIMER_TSICR_OFFSET 0x54
#define TIMER_TSICR_POSTED BIT(2)

static int disablePostedMode(void)
{
	mem_addr_t tsicr = DT_REG_ADDR(DT_NODELABEL(systick_timer)) + TIMER_TSICR_OFFSET;
	sys_write32(sys_read32(tsicr) & ~TIMER_TSICR_POSTED, tsicr);
	return 0;
}
SYS_INIT(disablePostedMode, PRE_KERNEL_1, 0);

int main(void)
{
	volatile struct r5_heartbeat *hb = (volatile struct r5_heartbeat *)R5_HEARTBEAT_ADDR;

	// Keep counting boots if our own magic is still in memory
	uint32_t boots = (hb->magic == R5_HEARTBEAT_MAGIC) ? hb->boots + 1 : 1;
	hb->magic = 0;
	hb->count = 0;
	hb->uptimeMs = 0;
	hb->boots = boots;
	barrier_dmem_fence_full();
	hb->magic = R5_HEARTBEAT_MAGIC;

	while (1) {
		k_msleep(R5_HEARTBEAT_PERIOD_MS);
		hb->uptimeMs = k_uptime_get_32();
		hb->count++;
	}
	return 0;
}
```
